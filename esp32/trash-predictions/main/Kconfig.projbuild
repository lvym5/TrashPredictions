## esp32/trash-predictions/main/Kconfig.projbuild
```kconfig
menu "TrashPredictions Config"
    config REPORT_ENDPOINT
        string "Endpoint to which to report data"
        default ""
    
    config SENSOR_ID
        string "ID of the sensor"
        default "0"

    config TRASH_CAN_DEPTH
        int "Depth of the trash can (cm)"
        default 0
endmenu
```
